## Kconfig
```kconfig
# Kconfig - general configuration options

mainmenu "ASR Feature Phone Configuration"

config BUILD_CP_TARGET
	bool "build cp image"
	default y
	help
	  Select this option if you want to build cp image.

choice
	prompt "cp sdk selection"
	default CP_SDK
	depends on BUILD_CP_TARGET

	config CP_SDK
		bool "CP SDK default"

	config CP_SDK009
		bool "CP SDK009"

	config CP_SDKLWG
		bool "CP SDKLWG"

	config CP_DM_SDK
		bool "CP DM SDK"

	config CP_ALIOS_SDK
		bool "CP ALIOS SDK"
endchoice

choice
	prompt "cp modem version"
	depends on BUILD_CP_TARGET
	default CP_LTEGSM

	config CP_LTEONLY
		bool "lte only"

	config CP_LTEGSM
		bool "lte gsm"

	config CP_LWG
		bool "lte wcdma gsm"

endchoice

config ENABLE_MUI
	bool "enable mUI"
	default y
	help
	  Select this option if you want using mUI as MMI solution(default ASR FP UI).
	  
config BUILD_GUI_TARGET
	bool "build gui image"
	depends on ENABLE_MUI
	default y
	help
	  Select this option if you want to build gui image.

config BUILD_GUI_TARGET_BY_CMAKE
	bool "build gui image by cmake"
	depends on BUILD_GUI_TARGET
	default y
	help
	  Select this option if you want to build gui image.
	  
config CREATE_HAL_TARGET
	bool "create hal image"
	default y
	help
	  Select this option if you want to create hal image.

menu "Debug Configurations"
	  
config CMAKE_DEBUG
	bool "print cmake debug message"
	default n
	help
	  Select this option if you want to print cmake debug info.

config DEBUG
	bool "build a debug version"
	default y
	help
	  Select this option if you want to build a debug version.
	  
config LINK_GUI_LIBRARY	  
	bool "link gui libraries"
	depends on ENABLE_MUI
	default y
	help
	  Select this option if you want to link gui library.
	  
config OUTPUT_DISASSEMBLY
	bool "Create a disassembly file"
	default n
	help
	  Create an .asm file with the assembly listing of the firmware

config BUILD_OUTPUT_BIN
	bool "Build a binary in BIN format"
	default y
	help
	  Build a binary in BIN format. This will build a ${TARGET}.bin file need
	  by some platforms.
	  
config OUTPUT_PS_EXTENSION
	bool "Platform Convertion Tools v4.01 with PS option extension"
	default y
	help
	  Platform Convertion Tools v4.01 with PS option extension
	  
config DBG_DEFAULT_PIN_CFG
	bool "enable API for checking default pin cfg"
	default n
	help
	  checking default pin cfg right or not.  
endmenu

menu "Release Configurations"

config OUTPUT_LIBRARY
	bool "Install library in release directory"
	default y
	help
	  All the AP side library will be installed in release directory
	  	  
config RELEASE_WITH_NO_ASR_UI
	bool "Source Code Release with NO ASR UI"
	default n
	# depends on SOURCE_CODE_RELEASE
	help
	  Release Source Code with NO ASR UI.	

config RELEASE_INSTALL_DIRECTORY
	string
	prompt "release directory"
	default "../rel"
	help
	  set source code release install directory

config INSTALL_CP
	bool "install cp source code to release directory"
	default n

config INSTALL_TOOL
	bool "install tool to release directory"
	default y

config INSTALL_SCRIPTS
	bool "install scripts to release directory"
	default y
	
endmenu

config BUILD_FROM_SOURCE_CODE
	bool "build feature phone from all source code"
	default y
	help
	  Select this option if you want to build gui image.

menu "Link Configuration"

config LINK_CUSTOM_SCATTER_FILE
	bool "link customized scatter file"
	default n
	help
	  Select this option to link customized scatter file.

config SCATTER_FILE
	string
	depends on LINK_CUSTOM_SCATTER_FILE
	prompt "scatter file"
	default "cp/csw/platform/dev_plat/build/Crane_DS_16M_Ram_16M_Flash_XIP_Common.sct"
	help
	  set scatter file

endmenu

source "driver/Kconfig"

config BUILD_CAMERA_TARGET
	bool "build camera image"
	depends on FP || MINIPHONE || WEARPHONE
	default y
	help
	  Select this option if you want to build camera image.

source "scripts/boards/Kconfig"
gsource "$ENV_VAR_BOARD_DIR/Kconfig.defconfig"
```

## common/Kconfig
```kconfig
# Kconfig - customer configuration options

menu "Customer Configuration"

config LOCK_KEY_SUPPORT
	bool "board support lock key function."
	default n
	help
	  Select this option if your board support lock key.

config EXT_PA_SUPPORT
	bool "board support external PA for Audio."
	default n
	help
	  Select this option if your board support external PA for Audio.

config FM_WITH_EXTERNAL_ANT
	bool "board support external antenan for FM Radio."
	default n
	help
	  Select this option if your board support external antenan for FM Radio.

config BL_GPIO_SUPPORT
	bool "board want to backlight controlled by GPIO."
	default n
	help
	  Select this option if your board want to backlight controlled by GPIO.
	  
config WITHOUT_PMIC_PWM
	bool "board want to backlight controlled by external pwm."
	default n
	help
	  Select this option if your board want to backlight controlled by external pwm.

endmenu
```

## driver/Kconfig
```kconfig
# Kconfig - driver configuration options

menu "Driver Configuration"

config HAL_SUPPORT_DM_REGISTER
	bool "build DM module to support DM register function"
	default n
	help
	  Select this option if you want to build /hal/modem/dm.

config BUILD_HAL_TEST
	bool "build hal/test"
	default y
	help
	  Select this option if you want to build hal/test.

config BUILD_ATA_TEST
	bool "build ATA test code"
	default n
	help
	  Select this option if you want to build ata test code.

config SUPPORT_UILOG
	bool
	depends on DEBUG
	default y
	help
	  Select this option if you want to build hal/log.
	  
config SUPPORT_UIDBG
	bool "support ui dbg"
	depends on DEBUG
	default y
	help
	  Select this option if you want to build hal/dbg.

config DEBUG_SHELL
	bool "[Experience]support uart shell function debug version"
	depends on SUPPORT_UIDBG
	default y
	help
	  Select this option if you want to support shell.

config DEBUG_UIUSK
	bool "[Experience]support uart keypad simulation debug version"
	depends on SUPPORT_UIDBG
	default y
	help
	  Select this option if you want to support uart keypad simulation.

config DEBUG_UIASS
	bool
	depends on SUPPORT_UIDBG
	default y
	help
	  Select this option if you want to support shell.

config DEBUG_UIMLK
	bool "[Experience]support app memory leak function debug"
	depends on SUPPORT_UIDBG
	default y
	help
	  Select this option if you want to support app memory leak.

config DEBUG_UIMEM
	bool
	depends on SUPPORT_UIDBG
	default n
	help
	  Select this option if you want to build a deeply memory debug version.

config DEBUG_TXCHK
	bool
	depends on SUPPORT_UIDBG
	default n
	help
	  Select this option if you want to build a stack check debug version.

config DEBUG_MCCHK
	bool
	depends on SUPPORT_UIDBG
	default n
	help
	  Select this option if you want to build a malloc statistics debug version.

config DEBUG_UICMD
	bool
	depends on DEBUG_SHELL
	depends on SUPPORT_UIDBG
	default n
	help
	  Select this option if you want to build a full shell cmd debug version.

choice
	prompt "sim enable"
	default MSYS_ENABLE_BOTH_SIM

	config MSYS_ONLY_ENABLE_SIM1
		bool "only enable sim1"

	config MSYS_ONLY_ENABLE_SIM2
		bool "only enable sim2"

	config MSYS_ENABLE_BOTH_SIM
		bool "enable both sim"
endchoice

choice
	prompt "AT interface solution"
	default MSYS_RIL

	config MSYS_RIL
		bool "ril"

	config MSYS_MINI_AT
		bool "mini AT"

	config DISABLE_AT_SUPPORT
		bool "disable AT support"
endchoice
	  
config BUILD_MSYS_RIL_WITH_SOURCE
	bool "using ril src for building target"
	depends on MSYS_RIL
	default n
	help
	  Select this option if you want to build target using source code.

config BUILD_MSYS_MINI_AT_WITH_SOURCE
	bool "using mini AT src for building target"
	depends on MSYS_MINI_AT
	default n
	help
	  Select this option if you want to build target using source code.
	  
config MUI_RIL_ADAPTER_SUPPORT
	bool "build mUI ril adapter module"
	depends on ENABLE_MUI
	default y
	help
	  Select this option if you want to include mUI ril adapter module.
	  
config ASR_MUI_SMS_HAL_FEATURE
	bool "build mUI sms hal module"
#	depends on MSYS_RIL_SUPPORT
	default y
	help
	  Select this option if you want to include mUI sms hal.

config BUILD_ASR_SMS_SOURCE_CODE
	bool "using sms src for building target"
	default n
	help
	  Select this option if you want to build target using source code.

config SUPPORT_SIM_HOTPLUG
	bool "enable sim card hotplug support(ui side)"
	default n
	help
	enable sim card hotplug feature
	
config SUPPORT_SOFTWARE_SIM_DETECT
	bool "enable sim card software sim detect"
	depends on SUPPORT_SIM_HOTPLUG
	default n
	help
	enable sim card software sim detect feature
	
config BUILD_MSYS_DBG_WITH_SOURCE
	bool "using dbg src for building target"
	default n
	help
	  Select this option if you want to build target using source code.

config ENABLE_MULTIMEDIA_MEM
	bool "enable multimedia large memory management support"
	default n
	help
	  Enable multimedia large memory management support.

config ENABLE_HAL_VERIFY_SUPPORT
	bool "enable hal verify support"
	default n
	help
	  Enable hal only support,for hal module verify.

config ENABLE_KEYPAD_SUPPORT
    bool "enable keypad support"
    default y
    help
      Enable keypad support.

config ENABLE_MINIPHONE_CAMERA
	bool "enable miniphone camera support"
	depends on BUILD_CAMERA_TARGET && MINIPHONE
	default y
	help
	  Enable miniphone camera support.

config ENABLE_HAL_BUILD_IN_CP
	bool "enable hal build for cp"
	default n
	help
	  enable hal build in cp.	
	  
config ENABLE_HAL_RELEASE_FOR_CP
	bool "enable hal release for cp"
	default n
	help
	  enable hal release for cp.	  

config BUILD_MHAL_IN_DM
	bool "build mhal in dm"
	default n
	help
	  build mhal in dm.	
	  
config SUPPORT_QRCODE
	bool "enable qr code library"
	default n
	help
		build open source qr code library

config SUPPORT_QRCODE_ZBAR
	bool "Zbar library"
	default n
	depends on SUPPORT_QRCODE
	help
		build open source qr code library

config SUPPORT_QRCODE_ZXING
	bool "Zxing library"
	default n
	depends on SUPPORT_QRCODE
	help
		build open source qr code library

config BUILD_QRCODE_ZXING_SOURCE_CODE
	bool "build zxing source code"
	default n
	depends on SUPPORT_QRCODE_ZXING
	help
		build zxing source code or link the library

config JRTC_VIDEO_CALL
	bool "enable juphoon video call(demo version)"
	default n
	help
	  enable juphoon video call.
	  
config JRTC_VIDEO_CALL_TEST
	bool "enable juphoon video call test"
	default n
	depends on JRTC_VIDEO_CALL  && ENABLE_HAL_KAWAII_MQTT
	help
	  enable juphoon video call test.	
	  
config MMI_SUPPORT_BLUETOOTH
	bool "enable bluetooth support"	
	default n
	help
	  Select this option if you want to support bluetooth.

config BTSERVICE_SIMULATION_TEST
	bool "enable btservice simulation test support"
	default n
	depends on MMI_SUPPORT_BLUETOOTH
	help
		send bt event when put some key
		
config ENABLE_HAL_KAWAII_MQTT
	bool "enable hal kawaii mqtt"
	default n
	help
	  enable hal kawayii mqtt.

config ENABLE_CAM_FULLSIZE_STREAM
	bool "enable camera full size stream"
	depends on BUILD_CAMERA_TARGET
	default n
	help
	  enable camera full size stream.

config ENABLE_CHARGER_SUPPORT
    bool "enable charger support"
    default y
    help
      Enable charger support.
endmenu

#source "driver/media/Kconfig"
source "driver/lcd/Kconfig"
```
